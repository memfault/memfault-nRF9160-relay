## CMakeLists.txt
```
#
# Copyright (c) 2021 Nordic Semiconductor
#
# SPDX-License-Identifier: LicenseRef-Nordic-5-Clause
#

cmake_minimum_required(VERSION 3.13.1)

find_package(Zephyr REQUIRED HINTS $ENV{ZEPHYR_BASE})
project(memfault_sample_udp)

# NORDIC SDK APP START
target_sources(app PRIVATE src/main.c)
# NORDIC SDK APP END

zephyr_include_directories(src)
zephyr_include_directories(config)
```

## Kconfig
```
#
# Copyright (c) 2021 Nordic Semiconductor ASA
#
# SPDX-License-Identifier: LicenseRef-Nordic-5-Clause
#

menu "Zephyr Kernel"
source "Kconfig.zephyr"
endmenu

menu "Memfault UDP Sample Settings"

config UDP_DATA_UPLOAD_SIZE_BYTES
	int "Number of bytes transmitted to the server"
	default 10

config UDP_DATA_UPLOAD_FREQUENCY_SECONDS
	int "How often data is transmitted to the server"
	default 900

config UDP_SERVER_ADDRESS_STATIC
	string "UDP server IP address"
	default "8.8.8.8"

config UDP_SERVER_PORT
	int "UDP server port number"
	default "2469"

config UDP_DATA_UPLOAD_VERSION_PREFIX
	string "A version prefix to identify the binary layout of UDP messages"
	default "v0"

endmenu

module = MEMFAULT_SAMPLE
module-str = Memfault sample
source "${ZEPHYR_BASE}/subsys/logging/Kconfig.template.log_config"
```

## west.yml
```
# The west manifest file (west.yml) for the nRF Connect SDK (NCS).
#
# The per-workspace west configuration file, ncs/.west/config,
# specifies the location of this manifest file like this:
#
#     [manifest]
#     path = nrf
#
# See the west documentation for more information:
#
# https://developer.nordicsemi.com/nRF_Connect_SDK/doc/latest/zephyr/guides/west/index.html

manifest:
  version: "0.10"

  # "remotes" is a list of locations where git repositories are cloned
  # and fetched from.
  remotes:
    # nRF Connect SDK GitHub organization.
    # NCS repositories are hosted here.
    - name: ncs
      url-base: https://github.com/nrfconnect
    # Third-party repository sources:
    - name: zephyrproject
      url-base: https://github.com/zephyrproject-rtos
    - name: throwtheswitch
      url-base: https://github.com/ThrowTheSwitch
    - name: armmbed
      url-base: https://github.com/ARMmbed
    - name: nanopb
      url-base: https://github.com/nanopb
    - name: alexa
      url-base: https://github.com/alexa
    - name: nordicsemi
      url-base: https://github.com/NordicSemiconductor
    - name: pelioniot
      url-base: https://github.com/PelionIoT
    - name: memfault
      url-base: https://github.com/memfault

  # If not otherwise specified, the projects below should be obtained
  # from the ncs remote.
  defaults:
    remote: ncs

  group-filter: [-homekit, -nrf-802154, -find-my]

  # "projects" is a list of git repositories which make up the NCS
  # source code.
  projects:

    # The Zephyr RTOS fork in the NCS, along with the subset of its
    # modules which NCS imports directly.
    #
    # https://developer.nordicsemi.com/nRF_Connect_SDK/doc/latest/zephyr/introduction/index.html
    # https://developer.nordicsemi.com/nRF_Connect_SDK/doc/latest/zephyr/guides/modules.html
    - name: zephyr
      repo-path: sdk-zephyr
      revision: 2541c598706e87d0475f650b9a27e89a701c58c6
      import:
        # In addition to the zephyr repository itself, NCS also
        # imports the contents of zephyr/west.yml at the above
        # revision. Only the projects explicitly named in the
        # following allowlist are imported.
        #
        # Note that the zephyr west extensions (like 'build', 'flash',
        # 'debug', etc.) are automatically provided by this import, so
        # there's no need to add a redundant west-commands: key for
        # the zephyr project.
        #
        # Please keep this list sorted alphabetically.
        name-allowlist:
          - canopennode
          - cmsis
          - civetweb
          - edtt
          - fatfs
          - hal_nordic
          - hal_st
          - libmetal
          - littlefs
          - loramac-node
          - lvgl
          - mbedtls
          - mcumgr
          - mipi-sys-t
          - net-tools
          - nrf_hw_models
          - open-amp
          - segger
          - tensorflow
          - tinycbor
          - tinycrypt
          - TraceRecorderSource

    # NCS repositories.
    #
    # Some of these are also Zephyr modules which have NCS-specific
    # changes.
    - name: mcuboot
      repo-path: sdk-mcuboot
      revision: bbca448b64fc7e0e10122dab6909649068c22a0e
      path: bootloader/mcuboot
    - name: nrfxlib
      repo-path: sdk-nrfxlib
      path: nrfxlib
      revision: e47d05deb577d45c3c2ea9d53958073f4246123c
    - name: trusted-firmware-m
      repo-path: sdk-trusted-firmware-m
      path: modules/tee/tfm
      revision: b9a9ba684026c9bab73ae7ddfb50daacc1138324
    - name: tfm-mcuboot # This is used by the trusted-firmware-m module.
      repo-path: sdk-mcuboot
      path: modules/tee/tfm-mcuboot
      revision: v1.7.2
    - name: openthread
      repo-path: sdk-openthread
      path: modules/lib/openthread
      revision: 9c01aff66245c3989536a8c96dae3c6ec6402d0d
    - name: matter
      repo-path: sdk-connectedhomeip
      path: modules/lib/matter
      revision: dddca7629f68a040e97104a74387b66ca753d715
      submodules:
        - name: nlio
          path: third_party/nlio/repo
        - name: nlassert
          path: third_party/nlassert/repo
        - name: pigweed
          path: third_party/pigweed/repo
    - name: nrf-802154
      repo-path: sdk-nrf-802154
      path: nrf-802154
      revision: a147927cf8ed43831dc2d8003017be8306724d61
      groups:
      - nrf-802154
    # Other third-party repositories.
    - name: cmock
      path: test/cmock
      revision: 9d092898ef26ece140d9225e037274b64d4f851e
      remote: throwtheswitch
    - name: unity
      path: test/cmock/vendor/unity
      revision: 74cde089e65c3435ce9aa87d5c69f4f16b7f6ade
      remote: throwtheswitch
    - name: mbedtls-nrf
      path: mbedtls
      repo-path: mbedtls
      revision: mbedtls-2.24.0
      remote: armmbed
    - name: nanopb
      path: modules/lib/nanopb
      revision: nanopb-0.4.2
      remote: nanopb
    - name: Alexa-Gadgets-Embedded-Sample-Code
      path: modules/alexa-embedded
      revision: face92d8c62184832793f518bb1f19379538c5c1
      remote: alexa
    - name: mbed-cloud-client
      path: modules/lib/pelion-dm
      revision: 4.9.0
      remote: pelioniot
    - name: cddl-gen
      remote: nordicsemi
      revision: 24f1b2b0c64c694b7f9ac1b7eab60b39236ca0bf
      path: modules/lib/cddl-gen
    - name: homekit
      repo-path: sdk-homekit
      revision: 4b637f0f8cd0e9881c238d10b4121b3712c5ba0d
      groups:
      - homekit
    - name: find-my
      repo-path: sdk-find-my
      revision: 07c8d591b47c4c3609f29871be031c9af39401e1
      groups:
      - find-my
    - name: memfault-firmware-sdk
      path: modules/lib/memfault-firmware-sdk
      revision: 0.21.0
      remote: memfault

  # West-related configuration for the nrf repository.
  self:
    # This repository should be cloned to ncs/nrf.
    path: nrf
    # This line configures west extensions which are currently only
    # for internal use by NCS maintainers.
    west-commands: scripts/west-commands.yml
```

## prj.conf
```kconfig
# General config
CONFIG_NEWLIB_LIBC=y
CONFIG_FPU=y

# Logging
CONFIG_LOG=y
CONFIG_LOG_MODE_IMMEDIATE=y
CONFIG_MEMFAULT_SAMPLE_LOG_LEVEL_DBG=y

# Network
CONFIG_NETWORKING=y
CONFIG_NET_NATIVE=n
CONFIG_NET_SOCKETS=y
CONFIG_NET_SOCKETS_OFFLOAD=y

CONFIG_NET_UDP=y
CONFIG_NET_SOCKETS_POSIX_NAMES=y

# LTE link control
CONFIG_LTE_LINK_CONTROL=y
CONFIG_LTE_NETWORK_MODE_LTE_M=y

# Necessary for this demo to work, but not generally
# if one wants to send UDP packets from the device
CONFIG_LTE_AUTO_INIT_AND_CONNECT=y

# Modem library
CONFIG_NRF_MODEM_LIB=y

# DK
CONFIG_DK_LIBRARY=y

# Memfault
CONFIG_MEMFAULT=y
CONFIG_MEMFAULT_NCS_LTE_METRICS=y
CONFIG_MEMFAULT_NCS_STACK_METRICS=y

# nRF9160 only, uses modem to store root CAs
CONFIG_MEMFAULT_ROOT_CERT_STORAGE_NRF9160_MODEM=y
CONFIG_MODEM_KEY_MGMT=y

# Store coredump to flash
CONFIG_MEMFAULT_NCS_INTERNAL_FLASH_BACKED_COREDUMP=y
CONFIG_MEMFAULT_COREDUMP_COLLECT_BSS_REGIONS=y

# Dependencies for flash storage
CONFIG_FLASH=y
CONFIG_IMG_MANAGER=y
CONFIG_BOOTLOADER_MCUBOOT=y
CONFIG_MCUBOOT_IMG_MANAGER=y

# Heap and stacks
CONFIG_HEAP_MEM_POOL_SIZE=8192
CONFIG_MAIN_STACK_SIZE=4096
CONFIG_SYSTEM_WORKQUEUE_STACK_SIZE=2048

#######################
# UDP sample-specific #
#######################
CONFIG_UDP_DATA_UPLOAD_SIZE_BYTES=508
CONFIG_UDP_DATA_UPLOAD_FREQUENCY_SECONDS=10
CONFIG_UDP_SERVER_ADDRESS_STATIC=""
CONFIG_UDP_SERVER_PORT=20001

CONFIG_MEMFAULT=y
CONFIG_MEMFAULT_NCS_PROJECT_KEY=""
```

## src/main.c
```c
/*
 * Copyright (c) 2020 Nordic Semiconductor ASA
 *
 * SPDX-License-Identifier: LicenseRef-Nordic-5-Clause
 */

#include <stdio.h>
#include <zephyr.h>

#include <dk_buttons_and_leds.h>
#include <net/socket.h>

#include "memfault/core/platform/device_info.h"
#include <memfault/core/data_packetizer.h>
#include <memfault/core/trace_event.h>
#include <memfault/metrics/metrics.h>
#include <memfault/ports/zephyr/http.h>

#include <logging/log.h>

LOG_MODULE_REGISTER(memfault_sample, CONFIG_MEMFAULT_SAMPLE_LOG_LEVEL);

static int client_fd;
static struct sockaddr_storage host_addr;
static struct k_work_delayable memfault_chunk_sender_work;

static char udp_message[CONFIG_UDP_DATA_UPLOAD_SIZE_BYTES];
char *udp_message_cursor = udp_message;
int udp_message_remaining_bytes = CONFIG_UDP_DATA_UPLOAD_SIZE_BYTES;

typedef struct UdpMessageChunkSection {
  char *start_addr;
  size_t size;
} sUdpMessageChunkSection;

static sUdpMessageChunkSection udp_message_chunk_section;

static int append_to_udp_message(const char *section, int section_size) {
  if (section_size > udp_message_remaining_bytes) {
    LOG_DBG("Message too big, increase CONFIG_UDP_DATA_UPLOAD_SIZE_BYTES");
    return 1;
  }
  strncpy(udp_message_cursor, section, udp_message_remaining_bytes);
  udp_message_remaining_bytes -= section_size;
  udp_message_cursor += section_size;
  return 0;
}

static void init_udp_message(void) {
  sMemfaultDeviceInfo device_info;
  memfault_platform_get_device_info(&device_info);

  append_to_udp_message(CONFIG_UDP_DATA_UPLOAD_VERSION_PREFIX,
                        sizeof(CONFIG_UDP_DATA_UPLOAD_VERSION_PREFIX));
  append_to_udp_message(CONFIG_MEMFAULT_NCS_PROJECT_KEY,
                        sizeof(CONFIG_MEMFAULT_NCS_PROJECT_KEY));
  append_to_udp_message(device_info.device_serial,
                        strlen((char *)device_info.device_serial) + 1);

  LOG_DBG("Finished initialization of UDP message buffer");

  udp_message_chunk_section = (sUdpMessageChunkSection){
      .size = udp_message_remaining_bytes,
      .start_addr = udp_message_cursor,
  };
}

#define UDP_IP_HEADER_SIZE 28
static void memfault_chunk_sender_work_fn(struct k_work *work) {
  size_t chunk_buffer_len = udp_message_chunk_section.size;
  size_t size_of_prelude = CONFIG_UDP_DATA_UPLOAD_SIZE_BYTES - chunk_buffer_len;
  const bool success = memfault_packetizer_get_chunk(
      udp_message_chunk_section.start_addr, &chunk_buffer_len);

  // under-documented edge-case: success but no data
  if (success && (chunk_buffer_len > 0)) {
    int err;
    size_t udp_message_size = size_of_prelude + chunk_buffer_len;

    printk("Transmitting UDP/IP payload of %d bytes to the ",
           udp_message_size + UDP_IP_HEADER_SIZE);
    printk("IP address %s, port number %d\n", CONFIG_UDP_SERVER_ADDRESS_STATIC,
           CONFIG_UDP_SERVER_PORT);

    err = send(client_fd, udp_message, udp_message_size, 0);
    if (err < 0) {
      printk("Failed to transmit UDP packet, %d\n", errno);
    }
  } else {
    printk("No Memfault chunks to upload!\n");
  }

  k_work_schedule(&memfault_chunk_sender_work,
                  K_SECONDS(CONFIG_UDP_DATA_UPLOAD_FREQUENCY_SECONDS));
}

static void init_memfault_chunks_sender(void) {
  k_work_init_delayable(&memfault_chunk_sender_work,
                        memfault_chunk_sender_work_fn);
}

static void server_disconnect(void) { (void)close(client_fd); }

static int server_init(void) {
  struct sockaddr_in *server4 = ((struct sockaddr_in *)&host_addr);

  server4->sin_family = AF_INET;
  server4->sin_port = htons(CONFIG_UDP_SERVER_PORT);

  inet_pton(AF_INET, CONFIG_UDP_SERVER_ADDRESS_STATIC, &server4->sin_addr);

  return 0;
}

static int server_connect(void) {
  int err;

  client_fd = socket(AF_INET, SOCK_DGRAM, IPPROTO_UDP);
  if (client_fd < 0) {
    printk("Failed to create UDP socket: %d\n", errno);
    server_disconnect();
    return err;
  }

  err = connect(client_fd, (struct sockaddr *)&host_addr,
                sizeof(struct sockaddr_in));
  if (err < 0) {
    printk("Failed to connect: %d\n", errno);
    server_disconnect();
    return err;
  }

  return 0;
}

void main(void) {
  int err;

  printk("Memfault over UDP sample has started\n");

  err = server_init();
  if (err) {
    printk("Failed to initialize UDP server connection\n");
    return;
  }

  err = server_connect();
  if (err) {
    printk("Failed to connect to UDP server\n");
    return;
  }

  init_udp_message();
  init_memfault_chunks_sender();
  k_work_schedule(&memfault_chunk_sender_work, K_NO_WAIT);
}
```
